## esp32-firmware/usb-hid-kybd/main/Kconfig.projbuild
```kconfig
menu "Wifi+HTTPD+GPIO Configuration"

    orsource "$IDF_PATH/examples/common_components/env_caps/$IDF_TARGET/Kconfig.env_caps"

    # 
    # Note: After making changes to this file, run 
    #    rm sdkconfig
    #    idf.py clean 
    # to ensure the changes take effect.
    #

    config EXAMPLE_WIFI_SSID
        string "WiFi SSID"
        default n
        help
            SSID (network name) for the example to connect to.

    config EXAMPLE_WIFI_PASSWORD
        string "WiFi Password"
        default n
        help
            WiFi password (WPA or WPA2) for the example to use.

    config EXAMPLE_BASIC_AUTH
        bool "Basic Authentication"
        default n
        help
            Not implemented; must be 'n'

    config HTTPD_LISTEN_PORT
        int "Port on which http server listens"
        default 52000
        help
            Port on which http server listens

    config HTTPD_MAX_REQ_HDR_LEN
        int "Max request header len"
        default 768
        help
            The maximum length of the request header.
    
    config HTTPD_MAX_URI_LEN
        int "Max URI len"
        default 512
        help
            The maximum length of the URI.

    #
    # F_PANEL connector GPIOs
    #
    config GPIO_INPUT_HDD_ACTIVE
        int "GPIO input pin 1 (for HDD ACT '+' from motherboard)"
        range ENV_GPIO_RANGE_MIN ENV_GPIO_IN_RANGE_MAX
        default 1
        help
            GPIO pin connected to motherboard HDD activity plus.

    config GPIO_OUTPUT_MOBO_POWER
        int "GPIO output pin to to pull down power on the motherboard"
        range ENV_GPIO_RANGE_MIN ENV_GPIO_OUT_RANGE_MAX
        default 3
        help
            GPIO output pin to to pull down power on the motherboard

    config GPIO_OUTPUT_MOBO_RESET
        int "GPIO output pin to pull down reset pin on motherboard"
        range ENV_GPIO_RANGE_MIN ENV_GPIO_OUT_RANGE_MAX
        default 2
        help
            GPIO output pin to pull down reset pin on motherboard
        
    #
    # Button GPIO inputs (active low)
    #
    config GPIO_INPUT_BTN_RESET
        int "GPIO input pin for reset button (active low)"
        range ENV_GPIO_RANGE_MIN ENV_GPIO_IN_RANGE_MAX
        default 10
        help
            GPIO pin connected to left (power cycle) button.

    config GPIO_INPUT_BTN_POWER
        int "GPIO input pin for power button (active low)"
        range ENV_GPIO_RANGE_MIN ENV_GPIO_IN_RANGE_MAX
        default 11
        help
            GPIO pin connected to right (reset) button.

    config GPIO_INPUT_BTN_OK
        int "GPIO input pin for OK button (active low)"
        range ENV_GPIO_RANGE_MIN ENV_GPIO_IN_RANGE_MAX
        default 14
        help
            GPIO pin connected to OK button.
        
    #
    # LED output GPIOs
    #
    config GPIO_OUTPUT_RGB_AMBER
        int "GPIO output pin for RGB amber LED"
        range ENV_GPIO_RANGE_MIN ENV_GPIO_OUT_RANGE_MAX
        default 15
        help
            GPIO pin number connect to RGB LED amber

    config GPIO_OUTPUT_RGB_GREEN
        int "GPIO output pin for RGB green LED"
        range ENV_GPIO_RANGE_MIN ENV_GPIO_OUT_RANGE_MAX
        default 16
        help
            GPIO pin number connect to RGB LED green

endmenu

menu "USB HID Device Example"

    choice DEVELOPMENT_BOARD_SELECTION
        prompt "Select the development board you are using"
        default ESP32_S3_USB_OTG
        help
            Select this option to choose the board for the example.

        config ESP32_S3_USB_OTG
            bool "ESP32 S3 USB OTG"
            depends on IDF_TARGET_ESP32S3

        config ESP32_S3_GENERIC
            bool "ESP32 S3 GENERIC"
            depends on IDF_TARGET_ESP32S3

        config ESP32_S2_GENERIC
            bool "ESP32 S2 GENERIC"
            depends on IDF_TARGET_ESP32S2

    endchoice

    choice HID_SUBCLASS
        prompt "HID Device"
        default SUBCLASS_KEYBOARD

        config SUBCLASS_MOUSE
            bool "Mouse"
        config SUBCLASS_KEYBOARD
            bool "Keyboard"
    endchoice

    config TUSB_VID
        hex "USB Device VID"
        default 0x303A
    config TUSB_PID
        hex "USB Device PID"
        default 0x8000
    config TUSB_MANUFACTURER
        string "USB Device Manufacture"
        default "Goelzer"
    config TUSB_PRODUCT
        string "Product Name"
        default "Remote USB Keyboard"

    config ENABLE_FULL_KEY_KEYBOARD
        bool "Enable Full Key Keyboard"
        default y

endmenu
```

## firmware-project/usb-hid-kybd/sdkconfig.defaults.example
```kconfig
# Set Wifi SSID and password here in quotes
CONFIG_EXAMPLE_WIFI_SSID="My Wifi Network"
CONFIG_EXAMPLE_WIFI_PASSWORD="password"
```
